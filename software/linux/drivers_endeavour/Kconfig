## software/linux/drivers_endeavour/Kconfig
```kconfig
config ENDEAVOUR_DRIVERS
	bool "Drivers for Endeavour SoC"
	depends on RISCV
	default y
	select SERIAL_CORE
	select SERIAL_CORE_CONSOLE
	select SERIAL_EARLYCON
	help
	  Drivers for Endeavour Soc.
```
